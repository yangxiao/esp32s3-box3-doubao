## main/Kconfig.projbuild
```kconfig
menu "Doubao AI Configuration"

    config DOUBAO_APP_ID
        string "Doubao App ID"
        default "5639366393"
        help
            Application ID from Doubao (ByteDance) console.

    config DOUBAO_ACCESS_KEY
        string "Doubao Access Key"
        default "gIuNcVfuAMugvNCxktm_Oi-qM4GYVxsB"
        help
            Access key from Doubao (ByteDance) console.

    config DOUBAO_APP_KEY
        string "Doubao App Key"
        default "PlgvMymc7f3tQnJ6"
        help
            App key for Doubao real-time dialog API.

    config DOUBAO_TTS_SPEAKER
        string "TTS Speaker Voice"
        default "zh_female_vv_jupiter_bigtts"
        help
            TTS voice name for Doubao speech synthesis.

    config WIFI_SSID
        string "WiFi SSID"
        default "diluke_merlin"
        help
            SSID of the WiFi network to connect to.

    config WIFI_PASSWORD
        string "WiFi Password"
        default "19851201"
        help
            Password of the WiFi network.

endmenu
```

## main/Kconfig.projbuild.example
```kconfig
menu "Doubao AI Configuration"

    config DOUBAO_APP_ID
        string "Doubao App ID"
        default "your_app_id_here"
        help
            Application ID from Doubao (ByteDance) console.

    config DOUBAO_ACCESS_KEY
        string "Doubao Access Key"
        default "your_access_key_here"
        help
            Access key from Doubao (ByteDance) console.

    config DOUBAO_APP_KEY
        string "Doubao App Key"
        default "your_app_key_here"
        help
            App key for Doubao real-time dialog API.

    config DOUBAO_TTS_SPEAKER
        string "TTS Speaker Voice"
        default "zh_male_yunzhou_jupiter_bigtts"
        help
            TTS voice name for Doubao speech synthesis.

    config WIFI_SSID
        string "WiFi SSID"
        default "your_wifi_ssid"
        help
            SSID of the WiFi network to connect to.

    config WIFI_PASSWORD
        string "WiFi Password"
        default "your_wifi_password"
        help
            Password of the WiFi network.

endmenu
```

## sdkconfig.defaults
```kconfig
# Target
CONFIG_IDF_TARGET="esp32s3"

# Flash
CONFIG_ESPTOOLPY_FLASHSIZE_16MB=y
CONFIG_ESPTOOLPY_FLASHMODE_QIO=y

# Partition table
CONFIG_PARTITION_TABLE_CUSTOM=y
CONFIG_PARTITION_TABLE_CUSTOM_FILENAME="partitions.csv"

# PSRAM
CONFIG_SPIRAM=y
CONFIG_SPIRAM_MODE_OCT=y
CONFIG_SPIRAM_SPEED_80M=y

# CPU
CONFIG_ESP_DEFAULT_CPU_FREQ_MHZ_240=y

# FreeRTOS
CONFIG_FREERTOS_HZ=1000

# Cache
CONFIG_ESP32S3_DATA_CACHE_64KB=y
CONFIG_ESP32S3_DATA_CACHE_LINE_64B=y

# TLS (for WSS)
CONFIG_ESP_TLS_USING_MBEDTLS=y
CONFIG_MBEDTLS_DYNAMIC_BUFFER=y
CONFIG_MBEDTLS_SSL_MAX_CONTENT_LEN=16384

# Logging
CONFIG_LOG_DEFAULT_LEVEL_INFO=y

# Wi-Fi
CONFIG_ESP_WIFI_STATIC_RX_BUFFER_NUM=10
CONFIG_ESP_WIFI_DYNAMIC_RX_BUFFER_NUM=32
CONFIG_ESP_WIFI_DYNAMIC_TX_BUFFER_NUM=32

# LWIP
CONFIG_LWIP_TCP_MSS=1440
CONFIG_LWIP_TCP_SND_BUF_DEFAULT=5744
CONFIG_LWIP_TCP_WND_DEFAULT=5744
```
